## firmware/common/Kconfig
```kconfig
menu "meshfind core"

    config MESHFIND_CRYPTO_MBEDTLS
        bool "Use mbedTLS for SHA-256 / ChaCha20-Poly1305 / X25519"
        default n
        help
            By default the portable reference implementation (the exact code
            that is vector-tested on the host) is used. Enabling this uses the
            mbedTLS shipped with ESP-IDF instead (hardware SHA). It requires
            CONFIG_MBEDTLS_CHACHA20_C, CONFIG_MBEDTLS_POLY1305_C,
            CONFIG_MBEDTLS_CHACHAPOLY_C and
            CONFIG_MBEDTLS_ECP_DP_CURVE25519_ENABLED (see
            sdkconfig.defaults.mbedtls). Not yet validated on hardware.

endmenu
```

## firmware/relay/main/Kconfig.projbuild
```kconfig
menu "meshfind relay"

    config MESHFIND_IS_GATEWAY
        bool "This node is a gateway (prints MFRPT lines on the console UART)"
        default n

    config MESHFIND_NODE_ID
        hex "Node id (0 = derive from the Wi-Fi MAC)"
        default 0x0

    config MESHFIND_POS_LOCAL_FRAME
        bool "Position is in a site-local frame (centimetres); otherwise WGS84 *1e7"
        default y

    config MESHFIND_NODE_X
        int "Node X (cm, or latitude*1e7)"
        default 0

    config MESHFIND_NODE_Y
        int "Node Y (cm, or longitude*1e7)"
        default 0

    config MESHFIND_NODE_Z
        int "Node Z (cm)"
        default 0

    config MESHFIND_NODE_ACCURACY_CM
        int "Installed-position accuracy (cm)"
        default 50

    config MESHFIND_ESPNOW_CHANNEL
        int "Wi-Fi channel used by the ESP-NOW mesh"
        default 1
        range 1 13

    config MESHFIND_AGGREGATE_MS
        int "Aggregate sightings of one key for this long before sealing a report"
        default 10000

endmenu
```

## firmware/tag/main/Kconfig.projbuild
```kconfig
menu "meshfind tag"

    config MESHFIND_TAG_SK0
        string "Near-owner chain seed SK_0 (64 hex chars)"
        default ""
        help
            From `python -m meshfind tag provision tag.json`. Empty = tag
            refuses to advertise. Copied to NVS on first boot.

    config MESHFIND_TAG_SEP_SK0
        string "Separated chain seed (64 hex chars)"
        default ""

    config MESHFIND_TAG_PRESENCE_KEY
        string "Owner-presence key (64 hex chars)"
        default ""

    config MESHFIND_TAG_EPOCH0
        int "Provisioning time, unix seconds (epoch 0 start)"
        default 0
        help
            Also used as the initial wall clock on first boot: flash the tag
            right after running `meshfind tag provision`.

    config MESHFIND_TAG_EPOCH_SECONDS
        int "Key rotation period in seconds"
        default 900

    config MESHFIND_TAG_SEPARATED_AFTER_MIN
        int "Enter separated mode after this many minutes without the owner"
        default 480

    config MESHFIND_TAG_PRESENCE_SCAN_PERIOD_S
        int "Seconds between short scans for the owner-presence beacon (0 = never)"
        default 60

    config MESHFIND_TAG_PRESENCE_SCAN_MS
        int "Owner-presence scan window in milliseconds (duty-cycled)"
        default 50
        range 10 1000
        help
            Advertising is paused for this window, then resumed. Keep it short:
            a 50 ms scan every 60 s adds only tens of uA to the modelled average.

    config MESHFIND_TAG_BATTERY_ADC_CHANNEL
        int "ADC1 channel wired to the battery divider (-1 = no battery sensing)"
        default -1
        range -1 9

    config MESHFIND_TAG_BATTERY_DIVIDER_X10
        int "Battery divider ratio x10 (20 = 1:1 divider)"
        default 20

    config MESHFIND_TAG_BATTERY_MV_EMPTY
        int "Battery millivolts considered empty"
        default 3300

    config MESHFIND_TAG_BATTERY_MV_FULL
        int "Battery millivolts considered full"
        default 4150

endmenu
```
